## atomvm/components/atomvm_babytalk/Kconfig
```kconfig
config AVM_ENABLE_BABYTALK_NIFS
    bool "Enable BabyTalk (speech) NIFs"
    default y

config BABYTALK_RESERVE_AT_BOOT
    bool "Reserve the engines' 84.5 KB of internal RAM at boot"
    default y
    depends on AVM_ENABLE_BABYTALK_NIFS
    help
        Transcription and speech need one contiguous 84.5 KB block of internal SRAM, which
        only exists early, before WiFi and the rest fragment the heap: so BabyTalk takes it
        when the VM starts. On a board where that RAM is needed for other things (a display's
        DMA buffers, say) turn this off; an app can then opt in at run time with
        babytalk:reserve_at_boot(true) (NVS namespace "babytalk", key "reserve") and a
        restart. The NVS value, when present, overrides this default either way.

config BABYTALK_YIELD
    bool "Speech work yields to the VM (a screen board)"
    default n
    depends on AVM_ENABLE_BABYTALK_NIFS
    help
        The speech engine's tasks (the worker, priority 5, and the kernels' helper on the
        other core, near the top) run at the AtomVM schedulers' priority instead, taking turns
        with them. Without it, a transcription or a wake-phrase window holds both cores and the
        VM stops for its length -- on a board with a screen, the screen freezes while the room
        is listened to. With it, the screen stays live and speech takes longer when the VM is
        busy.

config BABYTALK_STACKS_IN_PSRAM
    bool "BabyTalk's task stacks in PSRAM"
    default n
    depends on AVM_ENABLE_BABYTALK_NIFS && SPIRAM && FREERTOS_TASK_CREATE_ALLOW_EXT_MEM
    help
        The worker (12 KB: transcription and synthesis) and the audio task (4 KB) keep their
        stacks in PSRAM instead of internal RAM. On a board whose internal RAM is short (a
        display, TLS, the engines' pool), those 16 KB decide whether the mic's DMA buffers and
        the speech engine's scratch fit. The hot data is in the engines' SRAM pool either way;
        a stack in PSRAM costs little.

choice BABYTALK_BOARD
    prompt "BabyTalk audio board (the default; apps can pick another at run time)"
    default BABYTALK_BOARD_WAVESHARE_P4_WIFI6 if IDF_TARGET_ESP32P4
    default BABYTALK_BOARD_WAVESHARE_S3_CAM
    depends on AVM_ENABLE_BABYTALK_NIFS
    help
        The board the built-in audio driver (board_audio.c) assumes until the app says
        otherwise. Pins, codecs and the amp switch are run-time settings:
        babytalk:audio_config/1 picks a preset or overrides any field, so one firmware per
        chip serves every board built from BabyTalk's supported parts (ES7210, ES8311; amp
        and rail on a GPIO or an IO expander). No pin is touched before the first
        listen/play or audio_config call. See atomvm/README.md, "Your board's pins".

config BABYTALK_BOARD_WAVESHARE_S3_CAM
    bool "Waveshare ESP32-S3-CAM (ES7210 mics, ES8311 + NS4150B speaker, CH32V003 expander)"

config BABYTALK_BOARD_WAVESHARE_P4_WIFI6
    bool "Waveshare ESP32-P4-WIFI6 (ES8311 mic + speaker, NS4150B amp on GPIO 53)"
    depends on IDF_TARGET_ESP32P4

config BABYTALK_BOARD_LILYGO_T_LORA_PAGER
    bool "LilyGO T-LoRa Pager (ES8311 mic + speaker, NS4150B amp on an XL9555)"
    depends on IDF_TARGET_ESP32S3

config BABYTALK_BOARD_CUSTOM
    bool "Custom: another component implements board_audio.h"
    help
        For audio chips the built-in driver doesn't know. board_audio.c compiles to nothing;
        some other component in the firmware (your board's) must define every function in
        board_audio.h, and babytalk:audio_config/1 returns {error, custom_board}. That
        component can include board_audio.h by adding atomvm_babytalk to its REQUIRES.
endchoice
```

## atomvm/components/atomvm_mmrt/Kconfig
```kconfig
config AVM_ENABLE_MMRT_NIFS
    bool "Enable MMRT (int8/int4 vector kernel) NIFs"
    default y
    depends on IDF_TARGET_ESP32S3 || IDF_TARGET_ESP32P4
    help
        matvec/matmul on the chip's vector unit: the ESP32-S3's PIE, or the ESP32-P4's (row
        dot products), with an exact C path for anything they can't take.
```

## components/sram_pool/Kconfig
```kconfig
menu "BabyTalk engine memory (sram_pool)"
config SRAM_POOL_IN_PSRAM
    bool "Put the engines' shared 84.5 KB block in PSRAM"
    default n
    help
        The speech engines (MMRT's staging buffers, sanoTTS's arena) share one 84.5 KB block,
        by default in internal SRAM, where they run fastest. On a board short of internal RAM
        (a camera, a display, WiFi and TLS all want it) put it in PSRAM instead: everything
        works the same, a little slower (octal PSRAM) or noticeably slower (quad PSRAM).
        The block can then also be taken at any time, not only at boot.
endmenu
```
